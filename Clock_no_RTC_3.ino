// by EASYAMPER  05.03.2024

byte h;             //   для часов
byte m;             //   для минут
byte s;             //   для секунд
unsigned long t;    //   для исчисления времени (принимает большие значения)
unsigned long ser;  //   для исчисления времени (принимает большие значения)
   
void setup() {
Serial.begin(9600);
}

void loop() {
  if (millis() - t > 1000){        // выполняем каждую секунду
    t = millis();
    s++;
    Serial.println("s=",s);
  }

  if (s == 60) {              // вычисление минут и часов по секундам
    s = 0;                    // в 1ой минуте 60 сек
    m = m + 1;
  }
  if (m == 60) {              // в 1ом часе 60 минут
    m = 0;
    h = h + 1;
  }
  if (h == 24) {             // день в среднем равен 24 часа
    h = 0;
    m = 0;                   //   сброс счётчика, можно добавить счёт дней
    s = 0;                     
  }
  
}
